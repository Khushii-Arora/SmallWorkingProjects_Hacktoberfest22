 /***************************************************************************************
 * Name        : LED CUBE 8x8x8 74HC595
 * By          : Liam Jackson
 * Modified by : Anubhaw Sharma

/*Combined with Voxel512.ino to work with Voxel512 cube with an Arduino uno by Jonathan P. Powell, DMD   http://www.clockworksdental.com/
 
 Based on code by Joseph Francis (74hc595 SPI)
 and by chr at instructables
 http://www.instructables.com/id/Led-Cube-8x8x8/step70/Run-the-cube-on-an-Arduino/
 Font found somewhere
****************************************************************************************/
/* Modified to work with Voxel
 * Adriaan Delport 
 * Hackable Designs
 ***************************************************************************************/
 
#include <SPI.h>
#include <SoftwareSerial.h>
SoftwareSerial Blue(2, 3); /**Syntax: SoftwareSerial name(Rx pin,Tx pin)*/
long int data=-1;
long int password1 = 92;//CHANGE EFFECTS
long int password2 = 79; //CHANGE EFFECTS
int period= 1000;
unsigned long time_now=0;

#define XAXIS 0
#define YAXIS 1
#define ZAXIS 2

#define POS_X 0
#define NEG_X 1
#define POS_Z 2
#define NEG_Z 3
#define POS_Y 4
#define NEG_Y 5

#define BUTTON_PIN 8
#define RED_LED 5
#define GREEN_LED 7

#define TOTAL_EFFECTS 12
#define RAIN 0
#define PLANE_BOING 1
#define SEND_VOXELS 2
#define WOOP_WOOP 3
#define CUBE_JUMP 4
#define GLOW 5
#define TEXT 6
#define LIT 7

#define RAIN_TIME 260
#define PLANE_BOING_TIME 220
#define SEND_VOXELS_TIME 140
#define DROP_DOWN_TIME 50
#define WOOP_WOOP_TIME 350
#define CUBE_JUMP_TIME 200
#define GLOW_TIME 10
#define TEXT_TIME 450
#define CLOCK_TIME 1000

/*original TIMING*/
//#define RAIN_TIME 260
//#define PLANE_BOING_TIME 220
//#define SEND_VOXELS_TIME 140
//#define WOOP_WOOP_TIME 350
//#define CUBE_JUMP_TIME 200
//#define GLOW_TIME 8
//#define TEXT_TIME 300
//#define CLOCK_TIME 500

//uint8_t characters[10][8] = {
//  {0x3C, 0x42, 0x42, 0x42, 0x42, 0x42, 0x42, 0x3C}, //0
//  {0x10, 0x18, 0x14, 0x10, 0x10, 0x10, 0x10, 0x3C}, //1
//  {0x3C, 0x42, 0x40, 0x40, 0x3C, 0x02, 0x02, 0x7E}, //2
//  {0x3C, 0x40, 0x40, 0x3C, 0x40, 0x40, 0x42, 0x3C}, //3
//  {0x22, 0x22, 0x22, 0x22, 0x7E, 0x20, 0x20, 0x20}, //4
//  {0x7E, 0x02, 0x02, 0x3E, 0x40, 0x40, 0x42, 0x3C}, //5
//  {0x3C, 0x02, 0x02, 0x3E, 0x42, 0x42, 0x42, 0x3C}, //6
//  {0x3C, 0x40, 0x40, 0x40, 0x40, 0x40, 0x40, 0x40}, //7
//  {0x3C, 0x42, 0x42, 0x3C, 0x42, 0x42, 0x42, 0x3C}, //8
//  {0x3C, 0x42, 0x42, 0x42, 0x3C, 0x40, 0x40, 0x3C}, //9
//};

//*******************************************************************

uint8_t characters[128][8] = { 
{ 0x00,  0x00,  0x00,  0x00,  0x00,  0x00,  0x00,  0x00 },    // 0 :
    //    |          |
    //    |          |
    //    |          |
    //    |          |
    //    |          |
    //    |          |
    //    |          |
    //    |          |

  { 0x00,  0x3E,  0x41,  0x55,  0x41,  0x55,  0x49,  0x3E },    // 1 : 
    //    |          |
    //    |   *****  |
    //    |  *     * |
    //    |  * * * * |
    //    |  *     * |
    //    |  * * * * |
    //    |  *  *  * |
    //    |   *****  |

  { 0x00,  0x3E,  0x7F,  0x6B,  0x7F,  0x6B,  0x77,  0x3E },    // 2 : 
    //    |          |
    //    |   *****  |
    //    |  ******* |
    //    |  ** * ** |
    //    |  ******* |
    //    |  ** * ** |
    //    |  *** *** |
    //    |   *****  |

  { 0x00,  0x22,  0x77,  0x7F,  0x7F,  0x3E,  0x1C,  0x08 },    // 3 : 
    //    |          |
    //    |   *   *  |
    //    |  *** *** |
    //    |  ******* |
    //    |  ******* |
    //    |   *****  |
    //    |    ***   |
    //    |     *    |

  { 0x00,  0x08,  0x1C,  0x3E,  0x7F,  0x3E,  0x1C,  0x08 },    // 4 : 
    //    |          |
    //    |     *    |
    //    |    ***   |
    //    |   *****  |
    //    |  ******* |
    //    |   *****  |
    //    |    ***   |
    //    |     *    |

  { 0x00,  0x08,  0x1C,  0x2A,  0x7F,  0x2A,  0x08,  0x1C },    // 5 : 
    //    |          |
    //    |     *    |
    //    |    ***   |
    //    |   * * *  |
    //    |  ******* |
    //    |   * * *  |
    //    |     *    |
    //    |    ***   |

  { 0x00,  0x08,  0x1C,  0x3E,  0x7F,  0x3E,  0x08,  0x1C },    // 6 : 
    //    |          |
    //    |     *    |
    //    |    ***   |
    //    |   *****  |
    //    |  ******* |
    //    |   *****  |
    //    |     *    |
    //    |    ***   |

  { 0x00,  0x00,  0x1C,  0x3E,  0x3E,  0x3E,  0x1C,  0x00 },    // 7 : 
    //    |          |
    //    |          |
    //    |    ***   |
    //    |   *****  |
    //    |   *****  |
    //    |   *****  |
    //    |    ***   |
    //    |          |

  { 0xFF,  0xFF,  0xE3,  0xC1,  0xC1,  0xC1,  0xE3,  0xFF },    // 8 : 
    //    | ******** |
    //    | ******** |
    //    | ***   ** |
    //    | **     * |
    //    | **     * |
    //    | **     * |
    //    | ***   ** |
    //    | ******** |

  { 0x00,  0x00,  0x1C,  0x22,  0x22,  0x22,  0x1C,  0x00 },    // 9 :  
    //    |          |
    //    |          |
    //    |    ***   |
    //    |   *   *  |
    //    |   *   *  |
    //    |   *   *  |
    //    |    ***   |
    //    |          |

  { 0xFF,  0xFF,  0xE3,  0xDD,  0xDD,  0xDD,  0xE3,  0xFF },    // 10 : 

    //    | ******** |
    //    | ******** |
    //    | ***   ** |
    //    | ** *** * |
    //    | ** *** * |
    //    | ** *** * |
    //    | ***   ** |
    //    | ******** |

  { 0x00,  0x0F,  0x03,  0x05,  0x39,  0x48,  0x48,  0x30 },    // 11 : 
    //    |          |
    //    |     **** |
    //    |       ** |
    //    |      * * |
    //    |   ***  * |
    //    |  *  *    |
    //    |  *  *    |
    //    |   **     |

  { 0x00,  0x08,  0x3E,  0x08,  0x1C,  0x22,  0x22,  0x1C },    // 12 : 
    //    |          |
    //    |     *    |
    //    |   *****  |
    //    |     *    |
    //    |    ***   |
    //    |   *   *  |
    //    |   *   *  |
    //    |    ***   |

  { 0x00,  0x18,  0x14,  0x10,  0x10,  0x30,  0x70,  0x60 },    // 13 : 

    //    |          |
    //    |    **    |
    //    |    * *   |
    //    |    *     |
    //    |    *     |
    //    |   **     |
    //    |  ***     |
    //    |  **      |

  { 0x00,  0x0F,  0x19,  0x11,  0x13,  0x37,  0x76,  0x60 },    // 14 : 
    //    |          |
    //    |     **** |
    //    |    **  * |
    //    |    *   * |
    //    |    *  ** |
    //    |   ** *** |
    //    |  *** **  |
    //    |  **      |

  { 0x00,  0x08,  0x2A,  0x1C,  0x77,  0x1C,  0x2A,  0x08 },    // 15 : 
    //    |          |
    //    |     *    |
    //    |   * * *  |
    //    |    ***   |
    //    |  *** *** |
    //    |    ***   |
    //    |   * * *  |
    //    |     *    |

  { 0x00,  0x60,  0x78,  0x7E,  0x7F,  0x7E,  0x78,  0x60 },    // 16 : 
    //    |          |
    //    |  **      |
    //    |  ****    |
    //    |  ******  |
    //    |  ******* |
    //    |  ******  |
    //    |  ****    |
    //    |  **      |

  { 0x00,  0x03,  0x0F,  0x3F,  0x7F,  0x3F,  0x0F,  0x03 },    // 17 : 
    //    |          |
    //    |       ** |
    //    |     **** |
    //    |   ****** |
    //    |  ******* |
    //    |   ****** |
    //    |     **** |
    //    |       ** |

  { 0x00,  0x08,  0x1C,  0x2A,  0x08,  0x2A,  0x1C,  0x08 },    // 18 : 
    //    |          |
    //    |     *    |
    //    |    ***   |
    //    |   * * *  |
    //    |     *    |
    //    |   * * *  |
    //    |    ***   |
    //    |     *    |

  { 0x00,  0x66,  0x66,  0x66,  0x66,  0x00,  0x66,  0x66 },    // 19 : 
    //    |          |
    //    |  **  **  |
    //    |  **  **  |
    //    |  **  **  |
    //    |  **  **  |
    //    |          |
    //    |  **  **  |
    //    |  **  **  |

  { 0x00,  0x3F,  0x65,  0x65,  0x3D,  0x05,  0x05,  0x05 },    // 20 : 
    //    |          |
    //    |   ****** |
    //    |  **  * * |
    //    |  **  * * |
    //    |   **** * |
    //    |      * * |
    //    |      * * |
    //    |      * * |

  { 0x00,  0x0C,  0x32,  0x48,  0x24,  0x12,  0x4C,  0x30 },    // 21 : 
    //    |          |
    //    |     **   |
    //    |   **  *  |
    //    |  *  *    |
    //    |   *  *   |
    //    |    *  *  |
    //    |  *  **   |
    //    |   **     |

  { 0x00,  0x00,  0x00,  0x00,  0x00,  0x7F,  0x7F,  0x7F },    // 22 : 
    //    |          |
    //    |          |
    //    |          |
    //    |          |
    //    |          |
    //    |  ******* |
    //    |  ******* |
    //    |  ******* |

  { 0x00,  0x08,  0x1C,  0x2A,  0x08,  0x2A,  0x1C,  0x3E },    // 23 : 
    //    |          |
    //    |     *    |
    //    |    ***   |
    //    |   * * *  |
    //    |     *    |
    //    |   * * *  |
    //    |    ***   |
    //    |   *****  |

  { 0x00,  0x08,  0x1C,  0x3E,  0x7F,  0x1C,  0x1C,  0x1C },    // 24 : 
    //    |          |
    //    |     *    |
    //    |    ***   |
    //    |   *****  |
    //    |  ******* |
    //    |    ***   |
    //    |    ***   |
    //    |    ***   |

  { 0x00,  0x1C,  0x1C,  0x1C,  0x7F,  0x3E,  0x1C,  0x08 },    // 25 : 
    //    |          |
    //    |    ***   |
    //    |    ***   |
    //    |    ***   |
    //    |  ******* |
    //    |   *****  |
    //    |    ***   |
    //    |     *    |

  { 0x00,  0x08,  0x0C,  0x7E,  0x7F,  0x7E,  0x0C,  0x08 },    // 26 : 
    //    |          |
    //    |     *    |
    //    |     **   |
    //    |  ******  |
    //    |  ******* |
    //    |  ******  |
    //    |     **   |
    //    |     *    |

  { 0x00,  0x08,  0x18,  0x3F,  0x7F,  0x3F,  0x18,  0x08 },    // 27 : 
    //    |          |
    //    |     *    |
    //    |    **    |
    //    |   ****** |
    //    |  ******* |
    //    |   ****** |
    //    |    **    |
    //    |     *    |

  { 0x00,  0x00,  0x00,  0x70,  0x70,  0x70,  0x7F,  0x7F },    // 28 : 
    //    |          |
    //    |          |
    //    |          |
    //    |  ***     |
    //    |  ***     |
    //    |  ***     |
    //    |  ******* |
    //    |  ******* |

  { 0x00,  0x00,  0x14,  0x22,  0x7F,  0x22,  0x14,  0x00 },    // 29 : 
    //    |          |
    //    |          |
    //    |    * *   |
    //    |   *   *  |
    //    |  ******* |
    //    |   *   *  |
    //    |    * *   |
    //    |          |

  { 0x00,  0x08,  0x1C,  0x1C,  0x3E,  0x3E,  0x7F,  0x7F },    // 30 : 
    //    |          |
    //    |     *    |
    //    |    ***   |
    //    |    ***   |
    //    |   *****  |
    //    |   *****  |
    //    |  ******* |
    //    |  ******* |

  { 0x00,  0x7F,  0x7F,  0x3E,  0x3E,  0x1C,  0x1C,  0x08 },    // 31 : 
    //    |          |
    //    |  ******* |
    //    |  ******* |
    //    |   *****  |
    //    |   *****  |
    //    |    ***   |
    //    |    ***   |
    //    |     *    |

  { 0x00,  0x00,  0x00,  0x00,  0x00,  0x00,  0x00,  0x00 },    // 32 :  
    //    |          |
    //    |          |
    //    |          |
    //    |          |
    //    |          |
    //    |          |
    //    |          |
    //    |          |

  { 0x00,  0x18,  0x18,  0x18,  0x18,  0x18,  0x00,  0x18 },    // 33 : !
    //    |          |
    //    |    **    |
    //    |    **    |
    //    |    **    |
    //    |    **    |
    //    |    **    |
    //    |          |
    //    |    **    |

  { 0x00,  0x36,  0x36,  0x14,  0x00,  0x00,  0x00,  0x00 },    // 34 : "
    //    |          |
    //    |   ** **  |
    //    |   ** **  |
    //    |    * *   |
    //    |          |
    //    |          |
    //    |          |
    //    |          |

  { 0x00,  0x36,  0x36,  0x7F,  0x36,  0x7F,  0x36,  0x36 },    // 35 : #
    //    |          |
    //    |   ** **  |
    //    |   ** **  |
    //    |  ******* |
    //    |   ** **  |
    //    |  ******* |
    //    |   ** **  |
    //    |   ** **  |

  { 0x00,  0x08,  0x1E,  0x20,  0x1C,  0x02,  0x3C,  0x08 },    // 36 : $
    //    |          |
    //    |     *    |
    //    |    ****  |
    //    |   *      |
    //    |    ***   |
    //    |       *  |
    //    |   ****   |
    //    |     *    |

  { 0x00,  0x60,  0x66,  0x0C,  0x18,  0x30,  0x66,  0x06 },    // 37 : %
    //    |          |
    //    |  **      |
    //    |  **  **  |
    //    |     **   |
    //    |    **    |
    //    |   **     |
    //    |  **  **  |
    //    |      **  |

  { 0x00,  0x3C,  0x66,  0x3C,  0x28,  0x65,  0x66,  0x3F },    // 38 : &
    //    |          |
    //    |   ****   |
    //    |  **  **  |
    //    |   ****   |
    //    |   * *    |
    //    |  **  * * |
    //    |  **  **  |
    //    |   ****** |

  { 0x00,  0x18,  0x18,  0x18,  0x30,  0x00,  0x00,  0x00 },    // 39 : '
    //    |          |
    //    |    **    |
    //    |    **    |
    //    |    **    |
    //    |   **     |
    //    |          |
    //    |          |
    //    |          |

  { 0x00,  0x60,  0x30,  0x18,  0x18,  0x18,  0x30,  0x60 },    // 40 : (
    //    |          |
    //    |  **      |
    //    |   **     |
    //    |    **    |
    //    |    **    |
    //    |    **    |
    //    |   **     |
    //    |  **      |

  { 0x00,  0x06,  0x0C,  0x18,  0x18,  0x18,  0x0C,  0x06 },    // 41 : )
    //    |          |
    //    |      **  |
    //    |     **   |
    //    |    **    |
    //    |    **    |
    //    |    **    |
    //    |     **   |
    //    |      **  |

  { 0x00,  0x00,  0x36,  0x1C,  0x7F,  0x1C,  0x36,  0x00 },    // 42 : *
    //    |          |
    //    |          |
    //    |   ** **  |
    //    |    ***   |
    //    |  ******* |
    //    |    ***   |
    //    |   ** **  |
    //    |          |

  { 0x00,  0x00,  0x08,  0x08,  0x3E,  0x08,  0x08,  0x00 },    // 43 : +
    //    |          |
    //    |          |
    //    |     *    |
    //    |     *    |
    //    |   *****  |
    //    |     *    |
    //    |     *    |
    //    |          |

  { 0x00,  0x00,  0x00,  0x00,  0x30,  0x30,  0x30,  0x60 },    // 44 : ,
    //    |          |
    //    |          |
    //    |          |
    //    |          |
    //    |   **     |
    //    |   **     |
    //    |   **     |
    //    |  **      |

  { 0x00,  0x00,  0x00,  0x00,  0x3C,  0x00,  0x00,  0x00 },    // 45 : -
    //    |          |
    //    |          |
    //    |          |
    //    |          |
    //    |   ****   |
    //    |          |
    //    |          |
    //    |          |

  { 0x00,  0x00,  0x00,  0x00,  0x00,  0x00,  0x60,  0x60 },    // 46 : .
    //    |          |
    //    |          |
    //    |          |
    //    |          |
    //    |          |
    //    |          |
    //    |  **      |
    //    |  **      |

  { 0x00,  0x00,  0x06,  0x0C,  0x18,  0x30,  0x60,  0x00 },    // 47 : /
    //    |          |
    //    |          |
    //    |      **  |
    //    |     **   |
    //    |    **    |
    //    |   **     |
    //    |  **      |
    //    |          |

  { 0x00,  0x3C,  0x66,  0x6E,  0x76,  0x66,  0x66,  0x3C },    // 48 : 0
    //    |          |
    //    |   ****   |
    //    |  **  **  |
    //    |  ** ***  |
    //    |  *** **  |
    //    |  **  **  |
    //    |  **  **  |
    //    |   ****   |

  { 0x00,  0x18,  0x18,  0x38,  0x18,  0x18,  0x18,  0x7E },    // 49 : 1
    //    |          |
    //    |    **    |
    //    |    **    |
    //    |   ***    |
    //    |    **    |
    //    |    **    |
    //    |    **    |
    //    |  ******  |

  { 0x00,  0x3C,  0x66,  0x06,  0x0C,  0x30,  0x60,  0x7E },    // 50 : 2
    //    |          |
    //    |   ****   |
    //    |  **  **  |
    //    |      **  |
    //    |     **   |
    //    |   **     |
    //    |  **      |
    //    |  ******  |

  { 0x00,  0x3C,  0x66,  0x06,  0x1C,  0x06,  0x66,  0x3C },    // 51 : 3
    //    |          |
    //    |   ****   |
    //    |  **  **  |
    //    |      **  |
    //    |    ***   |
    //    |      **  |
    //    |  **  **  |
    //    |   ****   |

  { 0x00,  0x0C,  0x1C,  0x2C,  0x4C,  0x7E,  0x0C,  0x0C },    // 52 : 4
    //    |          |
    //    |     **   |
    //    |    ***   |
    //    |   * **   |
    //    |  *  **   |
    //    |  ******  |
    //    |     **   |
    //    |     **   |

  { 0x00,  0x7E,  0x60,  0x7C,  0x06,  0x06,  0x66,  0x3C },    // 53 : 5
    //    |          |
    //    |  ******  |
    //    |  **      |
    //    |  *****   |
    //    |      **  |
    //    |      **  |
    //    |  **  **  |
    //    |   ****   |

  { 0x00,  0x3C,  0x66,  0x60,  0x7C,  0x66,  0x66,  0x3C },    // 54 : 6
    //    |          |
    //    |   ****   |
    //    |  **  **  |
    //    |  **      |
    //    |  *****   |
    //    |  **  **  |
    //    |  **  **  |
    //    |   ****   |

  { 0x00,  0x7E,  0x66,  0x0C,  0x0C,  0x18,  0x18,  0x18 },    // 55 : 7
    //    |          |
    //    |  ******  |
    //    |  **  **  |
    //    |     **   |
    //    |     **   |
    //    |    **    |
    //    |    **    |
    //    |    **    |

  { 0x00,  0x3C,  0x66,  0x66,  0x3C,  0x66,  0x66,  0x3C },    // 56 : 8
    //    |          |
    //    |   ****   |
    //    |  **  **  |
    //    |  **  **  |
    //    |   ****   |
    //    |  **  **  |
    //    |  **  **  |
    //    |   ****   |

  { 0x00,  0x3C,  0x66,  0x66,  0x3E,  0x06,  0x66,  0x3C },    // 57 : 9
    //    |          |
    //    |   ****   |
    //    |  **  **  |
    //    |  **  **  |
    //    |   *****  |
    //    |      **  |
    //    |  **  **  |
    //    |   ****   |

  { 0x00,  0x00,  0x18,  0x18,  0x00,  0x18,  0x18,  0x00 },    // 58 : :
    //    |          |
    //    |          |
    //    |    **    |
    //    |    **    |
    //    |          |
    //    |    **    |
    //    |    **    |
    //    |          |

  { 0x00,  0x00,  0x18,  0x18,  0x00,  0x18,  0x18,  0x30 },    // 59 : ;
    //    |          |
    //    |          |
    //    |    **    |
    //    |    **    |
    //    |          |
    //    |    **    |
    //    |    **    |
    //    |   **     |

  { 0x00,  0x06,  0x0C,  0x18,  0x30,  0x18,  0x0C,  0x06 },    // 60 : <
    //    |          |
    //    |      **  |
    //    |     **   |
    //    |    **    |
    //    |   **     |
    //    |    **    |
    //    |     **   |
    //    |      **  |

  { 0x00,  0x00,  0x00,  0x3C,  0x00,  0x3C,  0x00,  0x00 },    // 61 : =
    //    |          |
    //    |          |
    //    |          |
    //    |   ****   |
    //    |          |
    //    |   ****   |
    //    |          |
    //    |          |

  { 0x00,  0x60,  0x30,  0x18,  0x0C,  0x18,  0x30,  0x60 },    // 62 : >
    //    |          |
    //    |  **      |
    //    |   **     |
    //    |    **    |
    //    |     **   |
    //    |    **    |
    //    |   **     |
    //    |  **      |

  { 0x00,  0x3C,  0x66,  0x06,  0x1C,  0x18,  0x00,  0x18 },    // 63 : ?
    //    |          |
    //    |   ****   |
    //    |  **  **  |
    //    |      **  |
    //    |    ***   |
    //    |    **    |
    //    |          |
    //    |    **    |

  { 0x00,  0x38,  0x44,  0x5C,  0x58,  0x42,  0x3C,  0x00 },    // 64 : @
    //    |          |
    //    |   ***    |
    //    |  *   *   |
    //    |  * ***   |
    //    |  * **    |
    //    |  *    *  |
    //    |   ****   |
    //    |          |

  { 0x00,  0x3C,  0x66,  0x66,  0x7E,  0x66,  0x66,  0x66 },    // 65 : A
    //    |          |
    //    |   ****   |
    //    |  **  **  |
    //    |  **  **  |
    //    |  ******  |
    //    |  **  **  |
    //    |  **  **  |
    //    |  **  **  |

  { 0x00,  0x7C,  0x66,  0x66,  0x7C,  0x66,  0x66,  0x7C },    // 66 : B
    //    |          |
    //    |  *****   |
    //    |  **  **  |
    //    |  **  **  |
    //    |  *****   |
    //    |  **  **  |
    //    |  **  **  |
    //    |  *****   |

  { 0x00,  0x3C,  0x66,  0x60,  0x60,  0x60,  0x66,  0x3C },    // 67 : C
    //    |          |
    //    |   ****   |
    //    |  **  **  |
    //    |  **      |
    //    |  **      |
    //    |  **      |
    //    |  **  **  |
    //    |   ****   |

  { 0x00,  0x7C,  0x66,  0x66,  0x66,  0x66,  0x66,  0x7C },    // 68 : D
    //    |          |
    //    |  *****   |
    //    |  **  **  |
    //    |  **  **  |
    //    |  **  **  |
    //    |  **  **  |
    //    |  **  **  |
    //    |  *****   |

  { 0x00,  0x7E,  0x60,  0x60,  0x7C,  0x60,  0x60,  0x7E },    // 69 : E
    //    |          |
    //    |  ******  |
    //    |  **      |
    //    |  **      |
    //    |  *****   |
    //    |  **      |
    //    |  **      |
    //    |  ******  |

  { 0x00,  0x7E,  0x60,  0x60,  0x7C,  0x60,  0x60,  0x60 },    // 70 : F
    //    |          |
    //    |  ******  |
    //    |  **      |
    //    |  **      |
    //    |  *****   |
    //    |  **      |
    //    |  **      |
    //    |  **      |

  { 0x00,  0x3C,  0x66,  0x60,  0x60,  0x6E,  0x66,  0x3C },    // 71 : G
    //    |          |
    //    |   ****   |
    //    |  **  **  |
    //    |  **      |
    //    |  **      |
    //    |  ** ***  |
    //    |  **  **  |
    //    |   ****   |

  { 0x00,  0x66,  0x66,  0x66,  0x7E,  0x66,  0x66,  0x66 },    // 72 : H
    //    |          |
    //    |  **  **  |
    //    |  **  **  |
    //    |  **  **  |
    //    |  ******  |
    //    |  **  **  |
    //    |  **  **  |
    //    |  **  **  |

  { 0x00,  0x3C,  0x18,  0x18,  0x18,  0x18,  0x18,  0x3C },    // 73 : I
    //    |          |
    //    |   ****   |
    //    |    **    |
    //    |    **    |
    //    |    **    |
    //    |    **    |
    //    |    **    |
    //    |   ****   |

  { 0x00,  0x1E,  0x0C,  0x0C,  0x0C,  0x6C,  0x6C,  0x38 },    // 74 : J
    //    |          |
    //    |    ****  |
    //    |     **   |
    //    |     **   |
    //    |     **   |
    //    |  ** **   |
    //    |  ** **   |
    //    |   ***    |

  { 0x00,  0x66,  0x6C,  0x78,  0x70,  0x78,  0x6C,  0x66 },    // 75 : K
    //    |          |
    //    |  **  **  |
    //    |  ** **   |
    //    |  ****    |
    //    |  ***     |
    //    |  ****    |
    //    |  ** **   |
    //    |  **  **  |

  { 0x00,  0x60,  0x60,  0x60,  0x60,  0x60,  0x60,  0x7E },    // 76 : L
    //    |          |
    //    |  **      |
    //    |  **      |
    //    |  **      |
    //    |  **      |
    //    |  **      |
    //    |  **      |
    //    |  ******  |

  { 0x00,  0x63,  0x77,  0x7F,  0x6B,  0x63,  0x63,  0x63 },    // 77 : M
    //    |          |
    //    |  **   ** |
    //    |  *** *** |
    //    |  ******* |
    //    |  ** * ** |
    //    |  **   ** |
    //    |  **   ** |
    //    |  **   ** |

  { 0x00,  0x63,  0x73,  0x7B,  0x6F,  0x67,  0x63,  0x63 },    // 78 : N
    //    |          |
    //    |  **   ** |
    //    |  ***  ** |
    //    |  **** ** |
    //    |  ** **** |
    //    |  **  *** |
    //    |  **   ** |
    //    |  **   ** |

  { 0x00,  0x3C,  0x66,  0x66,  0x66,  0x66,  0x66,  0x3C },    // 79 : O
    //    |          |
    //    |   ****   |
    //    |  **  **  |
    //    |  **  **  |
    //    |  **  **  |
    //    |  **  **  |
    //    |  **  **  |
    //    |   ****   |

  { 0x00,  0x7C,  0x66,  0x66,  0x66,  0x7C,  0x60,  0x60 },    // 80 : P
  
  
    //    |          |
    //    |  *****   |
    //    |  **  **  |
    //    |  **  **  |
    //    |  **  **  |
    //    |  *****   |
    //    |  **      |
    //    |  **      |

  { 0x00,  0x3C,  0x66,  0x66,  0x66,  0x6E,  0x3C,  0x06 },    // 81 : Q
    //    |          |
    //    |   ****   |
    //    |  **  **  |
    //    |  **  **  |
    //    |  **  **  |
    //    |  ** ***  |
    //    |   ****   |
    //    |      **  |

  { 0x00,  0x7C,  0x66,  0x66,  0x7C,  0x78,  0x6C,  0x66 },    // 82 : R
    //    |          |
    //    |  *****   |
    //    |  **  **  |
    //    |  **  **  |
    //    |  *****   |
    //    |  ****    |
    //    |  ** **   |
    //    |  **  **  |

  { 0x00,  0x3C,  0x66,  0x60,  0x3C,  0x06,  0x66,  0x3C },    // 83 : S
    //    |          |
    //    |   ****   |
    //    |  **  **  |
    //    |  **      |
    //    |   ****   |
    //    |      **  |
    //    |  **  **  |
    //    |   ****   |

  { 0x00,  0x7E,  0x5A,  0x18,  0x18,  0x18,  0x18,  0x18 },    // 84 : T
    //    |          |
    //    |  ******  |
    //    |  * ** *  |
    //    |    **    |
    //    |    **    |
    //    |    **    |
    //    |    **    |
    //    |    **    |

  { 0x00,  0x66,  0x66,  0x66,  0x66,  0x66,  0x66,  0x3E },    // 85 : U
    //    |          |
    //    |  **  **  |
    //    |  **  **  |
    //    |  **  **  |
    //    |  **  **  |
    //    |  **  **  |
    //    |  **  **  |
    //    |   *****  |

  { 0x00,  0x66,  0x66,  0x66,  0x66,  0x66,  0x3C,  0x18 },    // 86 : V
    //    |          |
    //    |  **  **  |
    //    |  **  **  |
    //    |  **  **  |
    //    |  **  **  |
    //    |  **  **  |
    //    |   ****   |
    //    |    **    |

  { 0x00,  0x63,  0x63,  0x63,  0x6B,  0x7F,  0x77,  0x63 },    // 87 : W
    //    |          |
    //    |  **   ** |
    //    |  **   ** |
    //    |  **   ** |
    //    |  ** * ** |
    //    |  ******* |
    //    |  *** *** |
    //    |  **   ** |

  { 0x00,  0x63,  0x63,  0x36,  0x1C,  0x36,  0x63,  0x63 },    // 88 : X
    //    |          |
    //    |  **   ** |
    //    |  **   ** |
    //    |   ** **  |
    //    |    ***   |
    //    |   ** **  |
    //    |  **   ** |
    //    |  **   ** |

  { 0x00,  0x66,  0x66,  0x66,  0x3C,  0x18,  0x18,  0x18 },    // 89 : Y
    //    |          |
    //    |  **  **  |
    //    |  **  **  |
    //    |  **  **  |
    //    |   ****   |
    //    |    **    |
    //    |    **    |
    //    |    **    |

  { 0x00,  0x7E,  0x06,  0x0C,  0x18,  0x30,  0x60,  0x7E },    // 90 : Z
    //    |          |
    //    |  ******  |
    //    |      **  |
    //    |     **   |
    //    |    **    |
    //    |   **     |
    //    |  **      |
    //    |  ******  |

  { 0x00,  0x1E,  0x18,  0x18,  0x18,  0x18,  0x18,  0x1E },    // 91 : [
    //    |          |
    //    |    ****  |
    //    |    **    |
    //    |    **    |
    //    |    **    |
    //    |    **    |
    //    |    **    |
    //    |    ****  |

  { 0x00,  0x00,  0x60,  0x30,  0x18,  0x0C,  0x06,  0x00 },    // 92 : \
    //    |          |
    //    |          |
    //    |  **      |
    //    |   **     |
    //    |    **    |
    //    |     **   |
    //    |      **  |
    //    |          |

  { 0x00,  0x78,  0x18,  0x18,  0x18,  0x18,  0x18,  0x78 },    // 93 : ]
    //    |          |
    //    |  ****    |
    //    |    **    |
    //    |    **    |
    //    |    **    |
    //    |    **    |
    //    |    **    |
    //    |  ****    |

  { 0x00,  0x08,  0x14,  0x22,  0x41,  0x00,  0x00,  0x00 },    // 94 : ^
    //    |          |
    //    |     *    |
    //    |    * *   |
    //    |   *   *  |
    //    |  *     * |
    //    |          |
    //    |          |
    //    |          |

  { 0x00,  0x00,  0x00,  0x00,  0x00,  0x00,  0x00,  0x7F },    // 95 : _
    //    |          |
    //    |          |
    //    |          |
    //    |          |
    //    |          |
    //    |          |
    //    |          |
    //    |  ******* |

  { 0x00,  0x0C,  0x0C,  0x06,  0x00,  0x00,  0x00,  0x00 },    // 96 : `
    //    |          |
    //    |     **   |
    //    |     **   |
    //    |      **  |
    //    |          |
    //    |          |
    //    |          |
    //    |          |

  { 0x00,  0x00,  0x00,  0x3C,  0x06,  0x3E,  0x66,  0x3E },    // 97 : a
    //    |          |
    //    |          |
    //    |          |
    //    |   ****   |
    //    |      **  |
    //    |   *****  |
    //    |  **  **  |
    //    |   *****  |

  { 0x00,  0x60,  0x60,  0x60,  0x7C,  0x66,  0x66,  0x7C },    // 98 : b
    //    |          |
    //    |  **      |
    //    |  **      |
    //    |  **      |
    //    |  *****   |
    //    |  **  **  |
    //    |  **  **  |
    //    |  *****   |

  { 0x00,  0x00,  0x00,  0x3C,  0x66,  0x60,  0x66,  0x3C },    // 99 : c
    //    |          |
    //    |          |
    //    |          |
    //    |   ****   |
    //    |  **  **  |
    //    |  **      |
    //    |  **  **  |
    //    |   ****   |

  { 0x00,  0x06,  0x06,  0x06,  0x3E,  0x66,  0x66,  0x3E },    // 100 : d
    //    |          |
    //    |      **  |
    //    |      **  |
    //    |      **  |
    //    |   *****  |
    //    |  **  **  |
    //    |  **  **  |
    //    |   *****  |

  { 0x00,  0x00,  0x00,  0x3C,  0x66,  0x7E,  0x60,  0x3C },    // 101 : e
    //    |          |
    //    |          |
    //    |          |
    //    |   ****   |
    //    |  **  **  |
    //    |  ******  |
    //    |  **      |
    //    |   ****   |

  { 0x00,  0x1C,  0x36,  0x30,  0x30,  0x7C,  0x30,  0x30 },    // 102 : f
    //    |          |
    //    |    ***   |
    //    |   ** **  |
    //    |   **     |
    //    |   **     |
    //    |  *****   |
    //    |   **     |
    //    |   **     |

  { 0x00,  0x00,  0x3E,  0x66,  0x66,  0x3E,  0x06,  0x3C },    // 103 : g
    //    |          |
    //    |          |
    //    |   *****  |
    //    |  **  **  |
    //    |  **  **  |
    //    |   *****  |
    //    |      **  |
    //    |   ****   |

  { 0x00,  0x60,  0x60,  0x60,  0x7C,  0x66,  0x66,  0x66 },    // 104 : h
    //    |          |
    //    |  **      |
    //    |  **      |
    //    |  **      |
    //    |  *****   |
    //    |  **  **  |
    //    |  **  **  |
    //    |  **  **  |

  { 0x00,  0x00,  0x18,  0x00,  0x18,  0x18,  0x18,  0x3C },    // 105 : i
    //    |          |
    //    |          |
    //    |    **    |
    //    |          |
    //    |    **    |
    //    |    **    |
    //    |    **    |
    //    |   ****   |

  { 0x00,  0x0C,  0x00,  0x0C,  0x0C,  0x6C,  0x6C,  0x38 },    // 106 : j
    //    |          |
    //    |     **   |
    //    |          |
    //    |     **   |
    //    |     **   |
    //    |  ** **   |
    //    |  ** **   |
    //    |   ***    |

  { 0x00,  0x60,  0x60,  0x66,  0x6C,  0x78,  0x6C,  0x66 },    // 107 : k
    //    |          |
    //    |  **      |
    //    |  **      |
    //    |  **  **  |
    //    |  ** **   |
    //    |  ****    |
    //    |  ** **   |
    //    |  **  **  |

  { 0x00,  0x18,  0x18,  0x18,  0x18,  0x18,  0x18,  0x18 },    // 108 : l
    //    |          |
    //    |    **    |
    //    |    **    |
    //    |    **    |
    //    |    **    |
    //    |    **    |
    //    |    **    |
    //    |    **    |

  { 0x00,  0x00,  0x00,  0x63,  0x77,  0x7F,  0x6B,  0x6B },    // 109 : m
    //    |          |
    //    |          |
    //    |          |
    //    |  **   ** |
    //    |  *** *** |
    //    |  ******* |
    //    |  ** * ** |
    //    |  ** * ** |

  { 0x00,  0x00,  0x00,  0x7C,  0x7E,  0x66,  0x66,  0x66 },    // 110 : n
    //    |          |
    //    |          |
    //    |          |
    //    |  *****   |
    //    |  ******  |
    //    |  **  **  |
    //    |  **  **  |
    //    |  **  **  |

  { 0x00,  0x00,  0x00,  0x3C,  0x66,  0x66,  0x66,  0x3C },    // 111 : o
    //    |          |
    //    |          |
    //    |          |
    //    |   ****   |
    //    |  **  **  |
    //    |  **  **  |
    //    |  **  **  |
    //    |   ****   |

  { 0x00,  0x00,  0x7C,  0x66,  0x66,  0x7C,  0x60,  0x60 },    // 112 : p
    //    |          |
    //    |          |
    //    |  *****   |
    //    |  **  **  |
    //    |  **  **  |
    //    |  *****   |
    //    |  **      |
    //    |  **      |

  { 0x00,  0x00,  0x3C,  0x6C,  0x6C,  0x3C,  0x0D,  0x0F },    // 113 : q
    //    |          |
    //    |          |
    //    |   ****   |
    //    |  ** **   |
    //    |  ** **   |
    //    |   ****   |
    //    |     ** * |
    //    |     **** |

  { 0x00,  0x00,  0x00,  0x7C,  0x66,  0x66,  0x60,  0x60 },    // 114 : r
    //    |          |
    //    |          |
    //    |          |
    //    |  *****   |
    //    |  **  **  |
    //    |  **  **  |
    //    |  **      |
    //    |  **      |

  { 0x00,  0x00,  0x00,  0x3E,  0x40,  0x3C,  0x02,  0x7C },    // 115 : s
    //    |          |
    //    |          |
    //    |          |
    //    |   *****  |
    //    |  *       |
    //    |   ****   |
    //    |       *  |
    //    |  *****   |

  { 0x00,  0x00,  0x18,  0x18,  0x7E,  0x18,  0x18,  0x18 },    // 116 : t
    //    |          |
    //    |          |
    //    |    **    |
    //    |    **    |
    //    |  ******  |
    //    |    **    |
    //    |    **    |
    //    |    **    |

  { 0x00,  0x00,  0x00,  0x66,  0x66,  0x66,  0x66,  0x3E },    // 117 : u
    //    |          |
    //    |          |
    //    |          |
    //    |  **  **  |
    //    |  **  **  |
    //    |  **  **  |
    //    |  **  **  |
    //    |   *****  |

  { 0x00,  0x00,  0x00,  0x00,  0x66,  0x66,  0x3C,  0x18 },    // 118 : v
    //    |          |
    //    |          |
    //    |          |
    //    |          |
    //    |  **  **  |
    //    |  **  **  |
    //    |   ****   |
    //    |    **    |

  { 0x00,  0x00,  0x00,  0x63,  0x6B,  0x6B,  0x6B,  0x3E },    // 119 : w
    //    |          |
    //    |          |
    //    |          |
    //    |  **   ** |
    //    |  ** * ** |
    //    |  ** * ** |
    //    |  ** * ** |
    //    |   *****  |

  { 0x00,  0x00,  0x00,  0x66,  0x3C,  0x18,  0x3C,  0x66 },    // 120 : x
    //    |          |
    //    |          |
    //    |          |
    //    |  **  **  |
    //    |   ****   |
    //    |    **    |
    //    |   ****   |
    //    |  **  **  |

  { 0x00,  0x00,  0x00,  0x66,  0x66,  0x3E,  0x06,  0x3C },    // 121 : y
    //    |          |
    //    |          |
    //    |          |
    //    |  **  **  |
    //    |  **  **  |
    //    |   *****  |
    //    |      **  |
    //    |   ****   |

  { 0x00,  0x00,  0x00,  0x3C,  0x0C,  0x18,  0x30,  0x3C },    // 122 : z
    //    |          |
    //    |          |
    //    |          |
    //    |   ****   |
    //    |     **   |
    //    |    **    |
    //    |   **     |
    //    |   ****   |

  { 0x00,  0x0E,  0x18,  0x18,  0x30,  0x18,  0x18,  0x0E },    // 123 : {
    //    |          |
    //    |     ***  |
    //    |    **    |
    //    |    **    |
    //    |   **     |
    //    |    **    |
    //    |    **    |
    //    |     ***  |

  { 0x00,  0x18,  0x18,  0x18,  0x00,  0x18,  0x18,  0x18 },    // 124 : |
    //    |          |
    //    |    **    |
    //    |    **    |
    //    |    **    |
    //    |          |
    //    |    **    |
    //    |    **    |
    //    |    **    |

  { 0x00,  0x70,  0x18,  0x18,  0x0C,  0x18,  0x18,  0x70 },    // 125 : }
    //    |          |
    //    |  ***     |
    //    |    **    |
    //    |    **    |
    //    |     **   |
    //    |    **    |
    //    |    **    |
    //    |  ***     |

  { 0x00,  0x00,  0x00,  0x3A,  0x6C,  0x00,  0x00,  0x00 },    // 126 : ~
    //    |          |
    //    |          |
    //    |          |
    //    |   *** *  |
    //    |  ** **   |
    //    |          |
    //    |          |
    //    |          |

  { 0x00,  0x08,  0x1C,  0x36,  0x63,  0x41,  0x41,  0x7F }    // 127 : 
    //    |          |
    //    |     *    |
    //    |    ***   |
    //    |   ** **  |
    //    |  **   ** |
    //    |  *     * |
    //    |  *     * |
    //    |  ******* |


};

uint8_t cube[8][8];
uint8_t currentEffect;

uint16_t timer;

uint64_t randomTimer;

bool autoRotate = true;
uint64_t lastEffectChange = 0;
uint32_t effectDuration = 20000;

bool loading;

void setup() {

  loading = true;
  randomTimer = 0;
  currentEffect = RAIN;

  SPI.begin();
  Blue.begin(9600); //setting serial communication for Bluetooth module
  SPI.beginTransaction(SPISettings(8000000, MSBFIRST, SPI_MODE0));

  pinMode(BUTTON_PIN, INPUT_PULLUP);
  pinMode(RED_LED, OUTPUT);
  pinMode(GREEN_LED, OUTPUT);

  randomSeed(analogRead(0));
  digitalWrite(GREEN_LED, HIGH);

}

void loop() {

/************************************BLUETOOTH CODE*/

//if(millis()&lt;time_now+period)
if(millis()-time_now>period)
{
  time_now =millis();
  // while(Blue.available()==0) ;
   if(Blue.available()>0) 
{
data = Blue.parseInt();

} 
//delay(400); 
if (data == password1)
{
  
  currentEffect=3;
  
   }
   
   if( data == password2)
   {
       currentEffect=5;

   }
}






/*******************************************/
  
  uint64_t currentTime = millis();
  randomTimer++;

  if (digitalRead(BUTTON_PIN) == LOW || (currentTime - lastEffectChange >= effectDuration && autoRotate)) {
    lastEffectChange = millis();
    clearCube();
    loading = true;
    timer = 0;
    currentEffect++;
    if (currentEffect == TOTAL_EFFECTS) {
      currentEffect = 0;
    }
    randomSeed(randomTimer);
    randomTimer = 0;
    digitalWrite(RED_LED, HIGH);
    digitalWrite(GREEN_LED, LOW);
    delay(500);
    digitalWrite(RED_LED, LOW);
    digitalWrite(GREEN_LED, HIGH);
  }

  switch (currentEffect ) {
    case RAIN: rain(); break;
    case PLANE_BOING: planeBoing(); break;
    case SEND_VOXELS: sendVoxels(); break;
    case WOOP_WOOP: woopWoop(); break;
    case CUBE_JUMP: cubeJump(); break;
    case GLOW: glow(); break;
    case TEXT: text((char*)"9876543210", 10); break;
    case LIT: lit(); break;
    case 8: wind(); break;
    case 9: opprain(); break;
    case 10: oppwind(); break;
    case 11: dropdown(); break;
    case 12: check(); break;
    case 13: around  (); break;
    
   
    default: rain();
  }
 //delay_ms(50);
  renderCube();

}

void renderCube() {
  for (uint8_t i = 0; i < 8; i++) {
    digitalWrite(SS, LOW);
    SPI.transfer(0x01 << i);
    for (uint8_t j = 0; j < 8; j++) {
      SPI.transfer(cube[i][j]);
    }
    digitalWrite(SS, HIGH);
  }
}
//checking co-ordinates of cube
void check(){
  if (loading) {
    clearCube();
    loading = false;
  }
  timer++;
  if (timer > RAIN_TIME) {
    timer = 0;
    //shift(POS_Y);
   
//    delay(1000);
    uint8_t numDrops = random(0, 5);
    for (uint8_t i = 0; i < 8; i++) {
      setVoxel(random(3, 8),random(0, 8),i);
    }
  }

}

void rain() {
  if (loading) {
    clearCube();
    loading = false;
  }
  timer++;
  if (timer > RAIN_TIME) {
    timer = 0;
    //shift(NEG_Y);
   
   shift(NEG_Y);
    uint8_t numDrops = random(0, 5);
    for (uint8_t i = 0; i < numDrops; i++) {
      
        // setVoxel(random(2, 6),7, random(2, 6));
      setVoxel(random(0, 8),7, random(0, 8));
      
      
    }
  }
}
void wind() {
  if (loading) {
    clearCube();
    loading = false;
  }
  timer++;
  if (timer > RAIN_TIME) {
    timer = 0;
   shift(POS_X);
    uint8_t numDrops = random(0, 5);
    for (uint8_t i = 0; i < numDrops; i++) {
   
      setVoxel(0,random(0, 8), random(0, 8));
      
      
    }
  }
}
void oppwind() {
  if (loading) {
    clearCube();
    loading = false;
  }
  timer++;
  if (timer > RAIN_TIME) {
    timer = 0;
   shift(NEG_X);
    uint8_t numDrops = random(0, 5);
    for (uint8_t i = 0; i < numDrops; i++) {
   
      setVoxel(7,random(0, 8), random(0, 8));
    }
  }
}

void opprain() {
  if (loading) {
    clearCube();
    loading = false;
  }
  timer++;
  if (timer > RAIN_TIME) {
    timer = 0;
   shift(POS_Y);
    uint8_t numDrops = random(0, 5);
    for (uint8_t i = 0; i < numDrops; i++) {
   
      setVoxel(random(0, 8),0,random(0, 8));
    }
  }
}
void effect_rain (uint8_t iterations)
{
  uint8_t i, ii;
  uint8_t rnd_x;
  uint8_t rnd_y;
  uint8_t rnd_num;

   shift(NEG_Y);
  
  for (ii=0;ii<iterations;++ii)
  {
    rnd_num = rand()%4;
    
    for (i=0; i < rnd_num;++i)
    {
      rnd_x = rand()%8;
      rnd_y = rand()%8;
      setVoxel(rnd_x,7,rnd_y);
    }
    
    //delay_ms(1000);
   
  }
}


uint8_t planePosition = 0;
uint8_t planeDirection = 0;
bool looped = false;

void planeBoing() {
  if (loading) {
    clearCube();
    uint8_t axis = random(0, 3);
    planePosition = random(0, 2) * 7;
    setPlane(axis, planePosition);
    if (axis == XAXIS) {
      if (planePosition == 0) {
        planeDirection = POS_X;
      } else {
        planeDirection = NEG_X;
      }
    } else if (axis == YAXIS) {
      if (planePosition == 0) {
        planeDirection = POS_Y;
      } else {
        planeDirection = NEG_Y;
      }
    } else if (axis == ZAXIS) {
      if (planePosition == 0) {
        planeDirection = POS_Z;
      } else {
        planeDirection = NEG_Z;
      }
    }
    timer = 0;
    looped = false;
    loading = false;
  }

  timer++;
  if (timer > PLANE_BOING_TIME) {
    timer = 0;
    shift(planeDirection);
    if (planeDirection % 2 == 0) {  //(means for plane direction=  +X  or +Y or +Z)
      planePosition++;
      if (planePosition == 7) {
        if (looped) {
          loading = true;
        } else {
          planeDirection++;
          looped = true;
        }
      }
    } else {
      planePosition--;
      if (planePosition == 0) {
        if (looped) {
          loading = true;
        } else {
          planeDirection--;
          looped = true;
        }
      }
    }
  }
}

uint8_t selX = 0;
uint8_t selY = 0;
uint8_t selZ = 0;
uint8_t sendDirection = 0;
bool sending = false;

void sendVoxels() {
  if (loading) {
    clearCube();
    for (uint8_t x = 0; x < 8; x++) {
      for (uint8_t z = 0; z < 8; z++) {
        setVoxel(x, random(0, 2) * 7, z);
      }
    }
    loading = false;
  }

  timer++;
  if (timer > SEND_VOXELS_TIME) {
    timer = 0;
    if (!sending) {
      selX = random(0, 8);
      selZ = random(0, 8);
      if (getVoxel(selX, 0, selZ)) {
        selY = 0;
        sendDirection = POS_Y;
      } else if (getVoxel(selX, 7, selZ)) {
        selY = 7;
        sendDirection = NEG_Y;
      }
      sending = true;
    } else {
      if (sendDirection == POS_Y) {
        selY++;
        setVoxel(selX, selY, selZ);
        clearVoxel(selX, selY - 1, selZ);
        if (selY == 7) {
          sending = false;
        }
      } else {
        selY--;
        setVoxel(selX, selY, selZ);
        clearVoxel(selX, selY + 1, selZ);
        if (selY == 0) {
          sending = false;
        }
      }
    }
  }
}

uint8_t cubeSize = 0;
bool cubeExpanding = true;

void woopWoop() {
  if (loading) {
    clearCube();
    cubeSize = 2;
    cubeExpanding = true;
    loading = false;
  }

  timer++;
  if (timer > WOOP_WOOP_TIME) {
    timer = 0;
    if (cubeExpanding) {
      cubeSize += 2;
      if (cubeSize == 8) {
        cubeExpanding = false;
      }
    } else {
      cubeSize -= 2;
      if (cubeSize == 2) {
        cubeExpanding = true;
      }
    }
    clearCube();
    drawCube(4 - cubeSize / 2, 4 - cubeSize / 2, 4 - cubeSize / 2, cubeSize);
  }
}

uint8_t xPos;
uint8_t yPos;
uint8_t zPos;

void cubeJump() {
  if (loading) {
    clearCube();
    xPos = random(0, 2) * 7;
    yPos = random(0, 2) * 7;
    zPos = random(0, 2) * 7;
    cubeSize = 8;
    cubeExpanding = false;
    loading = false;
  }

  timer++;
  if (timer > CUBE_JUMP_TIME) {
    timer = 0;
    clearCube();
    if (xPos == 0 && yPos == 0 && zPos == 0) {
      drawCube(xPos, yPos, zPos, cubeSize);
    } else if (xPos == 7 && yPos == 7 && zPos == 7) {
      drawCube(xPos + 1 - cubeSize, yPos + 1 - cubeSize, zPos + 1 - cubeSize, cubeSize);
    } else if (xPos == 7 && yPos == 0 && zPos == 0) {
      drawCube(xPos + 1 - cubeSize, yPos, zPos, cubeSize);
    } else if (xPos == 0 && yPos == 7 && zPos == 0) {
      drawCube(xPos, yPos + 1 - cubeSize, zPos, cubeSize);
    } else if (xPos == 0 && yPos == 0 && zPos == 7) {
      drawCube(xPos, yPos, zPos + 1 - cubeSize, cubeSize);
    } else if (xPos == 7 && yPos == 7 && zPos == 0) {
      drawCube(xPos + 1 - cubeSize, yPos + 1 - cubeSize, zPos, cubeSize);
    } else if (xPos == 0 && yPos == 7 && zPos == 7) {
      drawCube(xPos, yPos + 1 - cubeSize, zPos + 1 - cubeSize, cubeSize);
    } else if (xPos == 7 && yPos == 0 && zPos == 7) {
      drawCube(xPos + 1 - cubeSize, yPos, zPos + 1 - cubeSize, cubeSize);
    }
    if (cubeExpanding) {
      cubeSize++;
      if (cubeSize == 8) {
        cubeExpanding = false;
        xPos = random(0, 2) * 7;
        yPos = random(0, 2) * 7;
        zPos = random(0, 2) * 7;
      }
    } else {
      cubeSize--;
      if (cubeSize == 1) {
        cubeExpanding = true;
      }
    }
  }
}

bool glowing;
uint16_t glowCount = 0;

void glow() {
  if (loading) {
    clearCube();
    glowCount = 0;
    glowing = true;
    loading = false;
  }

  timer++;
  if (timer > GLOW_TIME) {
    timer = 0;
    if (glowing) {
      if (glowCount < 448) {
        do {
          selX = random(0, 8);
          selY = random(0, 8);
          selZ = random(0, 8);
        } while (getVoxel(selX, selY, selZ));
        setVoxel(selX, selY, selZ);
        glowCount++;
      } else if (glowCount < 512) {
        lightCube();
        glowCount++;
      } else {
        glowing = false;
        glowCount = 0;
      }
    } else {
      if (glowCount < 448) {
        do {
          selX = random(0, 8);
          selY = random(0, 8);
          selZ = random(0, 8);
        } while (!getVoxel(selX, selY, selZ));
        clearVoxel(selX, selY, selZ);
        glowCount++;
      } else {
        clearCube();
        glowing = true;
        glowCount = 0;
      }
    }
  }
}

uint8_t charCounter = 0;
uint8_t charPosition = 0;

void text(char string[], uint8_t len) {
  if (loading) {
    clearCube();
    charPosition = -1;
    charCounter = 0;
    loading = false;
  }
  timer++;
  if (timer > TEXT_TIME) {
    timer = 0;

    shift(POS_Z);
    charPosition++;

    if (charPosition == 7) {
      charCounter++;
      if (charCounter > len - 1) {
        charCounter = 0;
      }
      charPosition = 0;
    }

    if (charPosition == 0) {
      for (uint8_t i = 0; i < 8; i++) {
        cube[i][7] = characters[string[charCounter] - '\0'][i];
        
        //cube[i][0] = characters[string[charCounter] - '\0'][i]; //ORIGINAL CODE
      }
    }
  }
}

void lit() {
  if (loading) {
    clearCube();
    for(uint8_t i=0; i<8; i++) {
      for(uint8_t j=0; j<8; j++) {
        cube[i][j] = 0xFF;
      }
    }
    loading = false;
  }
}

void setVoxel(uint8_t x, uint8_t y, uint8_t z) {
  cube[7 - y][7 - z] |= (0x01 << x);
}

void clearVoxel(uint8_t x, uint8_t y, uint8_t z) {
  cube[7 - y][7 - z] ^= (0x01 << x);
}

bool getVoxel(uint8_t x, uint8_t y, uint8_t z) {
  return (cube[7 - y][7 - z] & (0x01 << x)) == (0x01 << x);
}

void setPlane(uint8_t axis, uint8_t i) {
  for (uint8_t j = 0; j < 8; j++) {
    for (uint8_t k = 0; k < 8; k++) {
      if (axis == XAXIS) {
        setVoxel(i, j, k);
      } else if (axis == YAXIS) {
        setVoxel(j, i, k);
      } else if (axis == ZAXIS) {
        setVoxel(j, k, i);
      }
    }
  }
}

void shift(uint8_t dir) {

  if (dir == POS_X) {
    for (uint8_t y = 0; y < 8; y++) {
      for (uint8_t z = 0; z < 8; z++) {
        cube[y][z] = cube[y][z] << 1;
      }
    }
  } else if (dir == NEG_X) {
    for (uint8_t y = 0; y < 8; y++) {
      for (uint8_t z = 0; z < 8; z++) {
        cube[y][z] = cube[y][z] >> 1;
      }
    }
  } else if (dir == POS_Y) {
    for (uint8_t y = 1; y < 8; y++) {
      for (uint8_t z = 0; z < 8; z++) {
        cube[y - 1][z] = cube[y][z];
      }
    }
    for (uint8_t i = 0; i < 8; i++) {
      cube[7][i] = 0;
    }
  } else if (dir == NEG_Y) {
    for (uint8_t y = 7; y > 0; y--) {
      for (uint8_t z = 0; z < 8; z++) {
        cube[y][z] = cube[y - 1][z];
      }
    }
    for (uint8_t i = 0; i < 8; i++) {
      cube[0][i] = 0;
    }
  } else if (dir == POS_Z) {
    for (uint8_t y = 0; y < 8; y++) {
      for (uint8_t z = 1; z < 8; z++) {
        cube[y][z - 1] = cube[y][z];
      }
    }
    for (uint8_t i = 0; i < 8; i++) {
      cube[i][7] = 0;
    }
  } else if (dir == NEG_Z) {
    for (uint8_t y = 0; y < 8; y++) {
      for (uint8_t z = 7; z > 0; z--) {
        cube[y][z] = cube[y][z - 1];
      }
    }
    for (uint8_t i = 0; i < 8; i++) {
      cube[i][0] = 0;
    }
  }
}

void drawCube(uint8_t x, uint8_t y, uint8_t z, uint8_t s) {
  for (uint8_t i = 0; i < s; i++) {
    setVoxel(x, y + i, z);
    setVoxel(x + i, y, z);
    setVoxel(x, y, z + i);
    setVoxel(x + s - 1, y + i, z + s - 1);
    setVoxel(x + i, y + s - 1, z + s - 1);
    setVoxel(x + s - 1, y + s - 1, z + i);
    setVoxel(x + s - 1, y + i, z);
    setVoxel(x, y + i, z + s - 1);
    setVoxel(x + i, y + s - 1, z);
    setVoxel(x + i, y, z + s - 1);
    setVoxel(x + s - 1, y, z + i);
    setVoxel(x, y + s - 1, z + i);
  }
}

void lightCube() {
  for (uint8_t i = 0; i < 8; i++) {
    for (uint8_t j = 0; j < 8; j++) {
      cube[i][j] = 0xFF;
    }
  }
}

void clearCube() {
  for (uint8_t i = 0; i < 8; i++) {
    for (uint8_t j = 0; j < 8; j++) {
      cube[i][j] = 0;
    }
  }
}


/************************************EXTRA CODE TESTING*********************************************/


void fireworks (int iterations, int n, int delay)
{
 // clearCube();

  int i,f,e;

  float origin_x = 3;
  float origin_y = 3;
  float origin_z = 3;

  int rand_y, rand_x, rand_z;

  float slowrate, gravity;

  // Particles and their position, x,y,z and their movement, dx, dy, dz
  float particles[n][6];

  for (i=0; i<iterations; ++i)
  {

    origin_x =random(0, 4); //rand()%4;
    origin_y = random(0, 4);//rand()%4;
    origin_z = random(0, 2);//rand()%2;
    origin_z +=5;
        origin_x +=2;
        origin_y +=2;

    // shoot a particle up in the air
    for (e=0;e<origin_z;++e)
    {
      setVoxel(origin_x,e,origin_y);
      //delay_ms(600+500*e);
     //clearCube();
    }

    // Fill particle array
    for (f=0; f<n; ++f)
    {
      // Position
      particles[f][0] = origin_x;
      particles[f][1] = origin_y;
      particles[f][2] = origin_z;
      
      rand_x =random(0, 200); //rand()%200;
      rand_y = random(0, 200); //rand()%200;
      rand_z = random(0, 200); //rand()%200;

      // Movement
      particles[f][3] = 1-(float)rand_x/100; // dx
      particles[f][4] = 1-(float)rand_y/100; // dy
      particles[f][5] = 1-(float)rand_z/100; // dz
    }

    // explode
    for (e=0; e<25; ++e)
    {
      slowrate = 1+tan((e+0.1)/20)*10;
      
      gravity = tan((e+0.1)/20)/2;

      for (f=0; f<n; ++f)
      {
        particles[f][0] += particles[f][3]/slowrate;
        particles[f][1] += particles[f][4]/slowrate;
        particles[f][2] += particles[f][5]/slowrate;
        particles[f][2] -= gravity;

        setVoxel(particles[f][0],particles[f][2],particles[f][1]);


      }

      //delay_ms(delay);
      //clearCube();
    }

  }

}

void delay_ms(uint16_t x)
{
  uint_fast8_t y, z;
  for ( ; x > 0 ; --x){
    for ( y = 0 ; y < 90 ; ++y){
      for ( z = 0 ; z < 6 ; ++z){
        asm volatile ("nop");
      }
    }
  }
}


//************************************ AROUND*********************************//
void around() {
  
  if (loading) {
    clearCube();
      
//    uint8_t axis = random(0, 2)*2;
     uint8_t axis = 0;
      
    planePosition = random(0, 2) * 7;
    setPlane(axis, planePosition);
    if (axis == XAXIS) {
      if (planePosition == 0) {
//        planeDirection = POS_X;
          planeDirection = POS_Z;
      } else {
        planeDirection = NEG_Z;
      }
    } else if (axis == YAXIS) {
      if (planePosition == 0) {
        planeDirection = POS_Y;
      } else {
        planeDirection = NEG_Y;
      }
    } else if (axis == ZAXIS) {
      if (planePosition == 0) {
        planeDirection = POS_X;
      } else {
        planeDirection = NEG_X;
      }
    }
    timer = 0;
    looped = false;
    loading = false;
  }

  timer++;
  if (timer > PLANE_BOING_TIME) {
    timer = 0;
    shift(planeDirection);           //starts shifting of plane.
    if (planeDirection % 2 == 0) {   //(means for plane direction=  +X  or +Y or +Z  i,e 0,2,4)
      planePosition++;
      if (planePosition == 7) {
        if (looped) {
          loading = true;
        } else {
          planeDirection++;
          setPlane(2, 7);
          looped = true;
        }
      }
    } else {                         //(means for plane direction=  -X  or -Y or -Z  i,e 1,3,)
     planePosition--;
      if (planePosition == 0) {
        if (looped) {
          loading = true;
        } else {
          planeDirection--;
           setPlane(2, 0);
          looped = true;
        }
      }
    }
  }
}

//********************************************************************************

uint8_t c=0;
void dropdown() {
  if (loading) {
    clearCube();
    for (uint8_t x = 0; x < 8; x++) {
      for (uint8_t z = 0; z < 8; z++) {
        //setVoxel(x, random(0, 2) * 7, z);
        setVoxel(x,  7, z);
      }
    }
    loading = false;
    selX=-1;
    selZ=0;
  }

  timer++;
  if (timer > DROP_DOWN_TIME) {
    timer = 0;
   
    if (!sending) {
      c++;
//      selX = random(0, 8);
//      selZ = random(0, 8);
       selX++;
      if(selX>7)
      {
        selX=0;
        selZ++;
        if(selZ>7)
        {
          selZ=0;
        }
      }
      
    

      if (getVoxel(selX, 0, selZ)) {
        selY = 0;
        sendDirection = POS_Y;
      }
      else if (getVoxel(selX, 7, selZ)) {
        selY = 7;
        sendDirection = NEG_Y;
      }
      sending = true;
    } else {
      if (sendDirection == POS_Y) {
        selY++;
        setVoxel(selX, selY, selZ);
        clearVoxel(selX, selY - 1, selZ);
        if (selY == 7) {
          sending = false;
        }
      } else {
        selY--;
        setVoxel(selX, selY, selZ);
        clearVoxel(selX, selY + 1, selZ);
        if (selY == 0) {
          sending = false;
        }
      }
    }
  }
}
